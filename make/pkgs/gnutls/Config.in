## make/pkgs/gnutls/Config.in
```kconfig
config FREETZ_PACKAGE_GNUTLS
	bool "GnuTLS 3.7.11/3.8.13 (binary only)"
	select FREETZ_LIB_libgnutls
	default n
	help
		GnuTLS is a project that aims to develop a library which provides a
		secure layer, over a reliable transport layer. Currently the GnuTLS
		library implements TLS 1.3, 1.2, 1.1, 1.0 protocols and SSL 3.0.

if FREETZ_PACKAGE_GNUTLS

	choice
		prompt "Version"
			default FREETZ_PACKAGE_GNUTLS_VERSION_CURRENT

		config FREETZ_PACKAGE_GNUTLS_VERSION_ABANDON
			bool "3.7.11 - DEPRECATED"
			depends on FREETZ_LIB_libgnutls_WITH_VERSION_ABANDON

		config FREETZ_PACKAGE_GNUTLS_VERSION_CURRENT
			bool "3.8.13"
			depends on FREETZ_LIB_libgnutls_WITH_VERSION_CURRENT

	endchoice

	config FREETZ_PACKAGE_GNUTLS_CERTTOOL
		bool "certtool"
		default n
		help
			Provides GnuTLS certtool utility.

	config FREETZ_PACKAGE_GNUTLS_UTILS
		bool "utils"
		default n
		help
			Provides gnutls-cli, gnutls-serv, psktool and srptool utilities.

endif # FREETZ_PACKAGE_GNUTLS
```

## make/pkgs/ser2net/Config.in
```kconfig
config FREETZ_PACKAGE_SER2NET
	bool "ser2net 3.5.4/4.6.8"
	default n
	help
		Serial to network interface, allows TCP/UDP to serial port
		connections.
		Configuration format differs by version (see help).

if FREETZ_PACKAGE_SER2NET

	choice
		prompt "Version"
			default FREETZ_PACKAGE_SER2NET_CURRENT

		config FREETZ_PACKAGE_SER2NET_ABANDON
			bool "3.5.4 - DEPRECATED"
#			depends on  (FREETZ_TARGET_UCLIBC_0_9_28 || FREETZ_TARGET_UCLIBC_0_9_29)
			help
				Ser2net v3 is a program for allowing network connections to
				serial ports. It supports RFC 2217 (remote control of serial
				portparameters), but you must have a compliant client.
				
				This version uses traditional config format (ser2net.conf).
				No additional libraries are required.

		config FREETZ_PACKAGE_SER2NET_CURRENT
			bool "4.6.8"
			depends on !(FREETZ_TARGET_UCLIBC_0_9_28 || FREETZ_TARGET_UCLIBC_0_9_29)
			select FREETZ_LIB_libgensio
			select FREETZ_LIB_libgensioosh
			select FREETZ_LIB_libgensiomdns
			select FREETZ_LIB_libyaml
			select FREETZ_LIB_libcrypt if FREETZ_TARGET_UCLIBC_HAS_multiple_libs
			select FREETZ_LIB_libpthread if FREETZ_TARGET_UCLIBC_HAS_multiple_libs
			help
				This is ser2net v4, a program for allowing connections between gensio
				accepters and gensio connectors. Generally, this would be a network
				connections to serial ports or IPMI Serial Over Lan (SOL) connections,
				but there are lots of gensios and lots of options. See gensio(5) for
				information on gensios.
				
				This version uses YAML configuration format (ser2net.yaml).
				Requires gensio and yaml libraries and also uClibc 0.9.30 or newer.

	endchoice

endif # FREETZ_PACKAGE_SER2NET
```

## make/pkgs/strace/Config.in
```kconfig
config FREETZ_PACKAGE_STRACE
	bool "strace 4.9/5.0/7.3 (binary only)"
	default n
	help
		strace - trace system calls and signals

		strace is a system call tracer, i.e. a debugging tool which prints out
		a trace of all the system calls made by another process/program.

if FREETZ_PACKAGE_STRACE

	choice
		prompt "Version"
			default FREETZ_PACKAGE_STRACE_VERSION_7

		config FREETZ_PACKAGE_STRACE_VERSION_4
			bool "4.9"
			depends on  (                                FREETZ_KERNEL_VERSION_2_6_13)

		config FREETZ_PACKAGE_STRACE_VERSION_5
			bool "5.0"
			depends on  (FREETZ_KERNEL_VERSION_2_MAX && !FREETZ_KERNEL_VERSION_2_6_13)

		config FREETZ_PACKAGE_STRACE_VERSION_7
			bool "7.3"
			depends on !(FREETZ_KERNEL_VERSION_2_MAX                                 )

	endchoice

endif # FREETZ_PACKAGE_STRACE
```

## make/pkgs/tailscale/Config.in
```kconfig
config FREETZ_PACKAGE_TAILSCALE
	bool "Tailscale 1.102.4 (static i386 binaries)"
	depends on FREETZ_TARGET_ARCH_X86
	default n
	help
		Installs the official static Tailscale and tailscaled binaries.
		Enable the service with /etc/init.d/rc.tailscale and authenticate
		using `tailscale up` after boot.
```
